/*
 * ArduinoBlocks.com
 * Project: SIMON.ino Shield - Test01
 * Author: Carlos Hernández
 * URL: http://www.arduinoblocks.com/web/project/181371
 */

#include <SoftwareSerial.h>

#include <Wire.h>
#include <Adafruit_GFX.h>
#include <Adafruit_SSD1306.h>
#include <ABLocks_TimerFreeTone.h>

int ValorA3;

byte LED_VERDE;
byte LED_ROJO;
byte LED_AZUL;
byte BTN_VERDE;
byte LED_AMARILLO;
byte BTN_ROJO;
byte BUZZER;
byte BTN_AZUL;
byte BTN_AMARILLO;
byte LED_ON;
byte SW_UP;
byte SW_DOWN;
byte SW_OK;

SoftwareSerial bt_serial(0,7);
Adafruit_SSD1306 oled_1(128,64, &Wire,-1);
static const uint8_t PROGMEM oled_data_0[] PROGMEM = {128, 64, 0xD5, 0x55, 0x55, 0x55, 0x55, 0x55, 0x55, 0x55, 0x55, 0xFD, 0x55,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 0x00, 0x00};

void fnc_dynamic_digitalWrite(int _pin, int _e){
  pinMode(_pin,OUTPUT);
  digitalWrite(_pin,_e);
}

int fnc_dynamic_digitalRead(int _pin){
  pinMode(_pin,INPUT);
  return digitalRead(_pin);
}

void setup()
{
  Serial.begin(9600);

bt_serial.begin(9600);

  oled_1.begin(SSD1306_SWITCHCAPVCC,0x3C);

pinMode(A3, INPUT);
pinMode(6, OUTPUT);
pinMode(A0, INPUT);
pinMode(A1, INPUT);
pinMode(A2, INPUT);
    oled_1.clearDisplay(); oled_1.display();
  LED_VERDE = 2;
  LED_ROJO = 3;
  LED_AZUL = 4;
  LED_AMARILLO = 5;
  BUZZER = 6;
  BTN_VERDE = 8;
  BTN_ROJO = 9;
  BTN_AZUL = 10;
  BTN_AMARILLO = 11;
  LED_ON = 13;
  SW_UP = 0;
  SW_DOWN = 1;
  SW_OK = 2;
  ValorA3 = map(analogRead(A3), 0,4064,0,10);
  oled_1.clearDisplay(); oled_1.display();
  oled_1.clearDisplay(); oled_1.drawBitmap(0,0,&oled_data_0[2],oled_data_0[0], oled_data_0[1],WHITE); oled_1.display();
  Serial.println(String("Simon.ino Shield Test-01"));
    fnc_dynamic_digitalWrite(LED_VERDE, HIGH);
    TimerFreeTone(6,500,250);
    delay(500);
    fnc_dynamic_digitalWrite(LED_VERDE, LOW);
    delay(500);
    fnc_dynamic_digitalWrite(LED_ROJO, HIGH);
    TimerFreeTone(6,800,250);
    delay(500);
    fnc_dynamic_digitalWrite(LED_ROJO, LOW);
    delay(500);
    fnc_dynamic_digitalWrite(LED_AZUL, HIGH);
    TimerFreeTone(6,1000,250);
    delay(500);
    fnc_dynamic_digitalWrite(LED_AZUL, LOW);
    delay(500);
    fnc_dynamic_digitalWrite(LED_AMARILLO, HIGH);
    TimerFreeTone(6,1200,250);
    delay(500);
    fnc_dynamic_digitalWrite(LED_AMARILLO, LOW);
    delay(500);

}


void loop()
{

    if ((map(analogRead(A3), 0,4064,0,10) != ValorA3)) {
      ValorA3 = map(analogRead(A3), 0,4064,0,10);
      TimerFreeTone(6,100,20);
      Serial.println(String("Analogico A3: ")+String(ValorA3));
      oled_1.clearDisplay(); oled_1.display();
      oled_1.setTextSize(1); oled_1.setTextColor(WHITE); oled_1.setCursor(0,16); oled_1.print(String("Analogico A3: ")+String(ValorA3)); oled_1.display();
      delay(50);

    }
    if (fnc_dynamic_digitalRead(BTN_VERDE)) {
      fnc_dynamic_digitalWrite(LED_VERDE, HIGH);
      Serial.println(String("Boton Verde"));
      oled_1.clearDisplay(); oled_1.display();
      oled_1.setTextSize(1); oled_1.setTextColor(WHITE); oled_1.setCursor(0,32); oled_1.print(String("Boton Verde")); oled_1.display();
      TimerFreeTone(6,500,500);
      delay(1000);
      fnc_dynamic_digitalWrite(LED_VERDE, LOW);

    }
    if (fnc_dynamic_digitalRead(BTN_ROJO)) {
      fnc_dynamic_digitalWrite(LED_ROJO, HIGH);
      Serial.println(String("Boton Rojo"));
      oled_1.clearDisplay(); oled_1.display();
      oled_1.setTextSize(1); oled_1.setTextColor(WHITE); oled_1.setCursor(0,32); oled_1.print(String("Boton Rojo")); oled_1.display();
      TimerFreeTone(6,800,500);
      delay(1000);
      fnc_dynamic_digitalWrite(LED_ROJO, LOW);

    }
    if (fnc_dynamic_digitalRead(BTN_AZUL)) {
      fnc_dynamic_digitalWrite(LED_AZUL, HIGH);
      Serial.println(String("Boton Azul"));
      oled_1.clearDisplay(); oled_1.display();
      oled_1.setTextSize(1); oled_1.setTextColor(WHITE); oled_1.setCursor(0,32); oled_1.print(String("Boton Azul")); oled_1.display();
      TimerFreeTone(6,1000,500);
      delay(1000);
      fnc_dynamic_digitalWrite(LED_AZUL, LOW);

    }
    if (fnc_dynamic_digitalRead(BTN_AMARILLO)) {
      fnc_dynamic_digitalWrite(LED_AMARILLO, HIGH);
      Serial.println(String("Boton Amarillo"));
      oled_1.clearDisplay(); oled_1.display();
      oled_1.setTextSize(1); oled_1.setTextColor(WHITE); oled_1.setCursor(0,32); oled_1.print(String("Boton Amarillo")); oled_1.display();
      TimerFreeTone(6,1200,500);
      delay(1000);
      fnc_dynamic_digitalWrite(LED_AMARILLO, LOW);

    }
    if (digitalRead(A0)) {
      fnc_dynamic_digitalWrite(LED_VERDE, HIGH);
      fnc_dynamic_digitalWrite(LED_ROJO, HIGH);
      Serial.println(String("Boton UP"));
      oled_1.clearDisplay(); oled_1.display();
      oled_1.setTextSize(1); oled_1.setTextColor(WHITE); oled_1.setCursor(0,32); oled_1.print(String("Boton UP")); oled_1.display();
      TimerFreeTone(6,1000,500);
      delay(1000);
      fnc_dynamic_digitalWrite(LED_VERDE, LOW);
      fnc_dynamic_digitalWrite(LED_ROJO, LOW);

    }
    if (digitalRead(A1)) {
      fnc_dynamic_digitalWrite(LED_AMARILLO, HIGH);
      fnc_dynamic_digitalWrite(LED_AZUL, HIGH);
      Serial.println(String("Boton Down"));
      oled_1.clearDisplay(); oled_1.display();
      oled_1.setTextSize(1); oled_1.setTextColor(WHITE); oled_1.setCursor(0,32); oled_1.print(String("Boton DOWN")); oled_1.display();
      TimerFreeTone(6,1200,500);
      delay(1000);
      fnc_dynamic_digitalWrite(LED_AMARILLO, LOW);
      fnc_dynamic_digitalWrite(LED_AZUL, LOW);

    }
    if (digitalRead(A2)) {
      fnc_dynamic_digitalWrite(LED_ON, HIGH);
      Serial.println(String("Boton OK"));
      oled_1.clearDisplay(); oled_1.display();
      oled_1.setTextSize(1); oled_1.setTextColor(WHITE); oled_1.setCursor(0,32); oled_1.print(String("Boton OK")); oled_1.display();
      TimerFreeTone(6,1400,500);
      delay(1000);
      fnc_dynamic_digitalWrite(LED_ON, LOW);

    }

}
  
  
